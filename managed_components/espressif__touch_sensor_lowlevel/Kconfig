## managed_components/espressif__touch_sensor_lowlevel/Kconfig
```kconfig
menu "Touch sensor lowlevel"

    config TOUCH_SENSOR_LOWLEVEL_SIMULATOR
        bool "Touch sensor lowlevel simulator"
        depends on IDF_TARGET_LINUX
        default y if IDF_TARGET_LINUX
        default n
        help
        Enable touch sensor lowlevel driver simulator.

    config TOUCH_SENSOR_LOWLEVEL_SIMULATOR_REALTIME
        bool "Touch sensor lowlevel simulator realtime"
        depends on TOUCH_SENSOR_LOWLEVEL_SIMULATOR
        default n
        help
        Enable touch sensor low level driver simulator realtime mode.
        The new data callback will be called with the real time data.

    choice TOUCH_SENSOR_LOWLEVEL_SIMULATOR_TARGET
        prompt "Simulator target"
        depends on TOUCH_SENSOR_LOWLEVEL_SIMULATOR
        default TOUCH_SENSOR_LOWLEVEL_SIMULATOR_TARGET_ESP32S2S3

        config TOUCH_SENSOR_LOWLEVEL_SIMULATOR_TARGET_ESP32S2S3
            bool "ESP32-S2/S3"
            help
            Enable touch sensor lowlevel driver simulator for ESP32-S2/S3.

        config TOUCH_SENSOR_LOWLEVEL_SIMULATOR_TARGET_ESP32P4
            bool "ESP32-P4"
            help
            Enable touch sensor lowlevel driver simulator for ESP32-P4.
    endchoice

endmenu
```

## sdkconfig.defaults
```kconfig
CONFIG_IDF_TARGET="esp32s3"
CONFIG_ESPTOOLPY_FLASHMODE_DIO=y
CONFIG_ESPTOOLPY_FLASHSIZE_8MB=y

CONFIG_BOOTLOADER_COMPILER_OPTIMIZATION_PERF=y
CONFIG_BOOTLOADER_LOG_LEVEL_NONE=y

CONFIG_PARTITION_TABLE_CUSTOM=y
CONFIG_PARTITION_TABLE_CUSTOM_FILENAME="partitions.csv"
# set external SPIRAM
CONFIG_SPIRAM=y
CONFIG_SPIRAM_MODE_OCT=y
CONFIG_SPIRAM_TYPE_AUTO=y
CONFIG_SPIRAM_SPEED_80M=y

CONFIG_ESP_DEFAULT_CPU_FREQ_MHZ_240=y
CONFIG_ESP32S3_INSTRUCTION_CACHE_32KB=y
CONFIG_ESP32S3_DATA_CACHE_64KB=y
CONFIG_ESP32S3_DATA_CACHE_LINE_64B=y
CONFIG_ESP_SYSTEM_ALLOW_RTC_FAST_MEM_AS_HEAP=n
CONFIG_ESP_INT_WDT=n
CONFIG_ESP_TASK_WDT_EN=n

CONFIG_XPT2046_INTERRUPT_MODE=y
CONFIG_XPT2046_CONVERT_ADC_TO_COORDS=n


CONFIG_LV_USE_LOG=y
CONFIG_LV_LOG_LEVEL_INFO=y
CONFIG_LV_LOG_LEVEL=1
CONFIG_LV_COLOR_16_SWAP=y
CONFIG_LV_USE_CLIB_MALLOC=y
```
